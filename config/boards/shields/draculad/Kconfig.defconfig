## config/boards/shields/draculad/Kconfig.defconfig
```kconfig
if SHIELD_DRACULAD_LEFT

config ZMK_KEYBOARD_NAME
    default "DracuLad Left"

config ZMK_SPLIT_BLE_ROLE_CENTRAL
    default y

endif

if SHIELD_DRACULAD_RIGHT

config ZMK_KEYBOARD_NAME
    default "DracuLad Right"

endif

if SHIELD_DRACULAD_LEFT || SHIELD_DRACULAD_RIGHT

config ZMK_SPLIT
    default y

endif
```

## config/west.yml
```yaml
manifest:
    remotes:
      - name: zmkfirmware
        url-base: https://github.com/zmkfirmware
      - name: xzebra
        url-base: https://github.com/xzebra
    projects:
      - name: zmk
        remote: zmkfirmware
        revision: main   
        import: app/west.yml
    self:
      path: config
```
